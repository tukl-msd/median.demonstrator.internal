/dts-v1/;
/plugin/;

/ {
	compatible = "xlnx,zynq-7000";
	
	fragment_1 {
		target-path = "/";
		
		__overlay__ {
			vio_0: vio {
				compatible = "jf,vio-1.0.0";
				
				jf,stpg = <&stpg_0>;
				xlnx,vtc = <&vtc_0>;
				dmas = <&axi_vdma_out 0 &axi_vdma_in 0>;
				dma-names = "vdma_out", "vdma_in";
			};
		};
	};

};