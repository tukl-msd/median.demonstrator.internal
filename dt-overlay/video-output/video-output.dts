/dts-v1/;
/plugin/;

/ {
	compatible = "xlnx,zynq-7000";
	
	fragment_1 {
		target-path = "/";
		
		__overlay__ {
			video_output_0: video_output {
				compatible = "jf,video-output-1.0.0";
				
				xlnx,vtc = <&vtc_0>;
				dmas = <&axi_vdma_out 0 &axi_vdma_out 0>;
				dma-names = "vdma_out", "vdma_in";
			};
		};
	};

};